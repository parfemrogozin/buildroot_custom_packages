## bogofilter/Config.in
```kconfig
config BR2_PACKAGE_BOGOFILTER
	bool "bogofilter"
	select BR2_PACKAGE_BERKELEYDB	
	help
	  Bogofilter - mail filter
	  The Bogofilter application is a mail filter that classifies mail as spam or ham (non-spam) by a statistical analysis of the message's header and content (body).
	  https://bogofilter.sourceforge.io
```

## procmail/Config.in
```kconfig
config BR2_PACKAGE_PROCMAIL
	bool "procmail"
	help
	  Procmail - autonomous mail processor
	  Useful for filtering and sorting incoming mail.
	  http://www.linuxfromscratch.org/blfs/view/svn/basicnet/procmail.html
```
